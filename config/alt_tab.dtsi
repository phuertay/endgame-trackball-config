/*
 * Left encoder window cycle.
 *
 * CW taps Esc, CCW taps Shift+Esc, with Left Alt held. That is Alt+Esc /
 * Alt+Shift+Esc: each click sends the focused window to the bottom of the
 * stack or brings the bottom window back up. The two directions are inverses,
 * including after the window has already opened. Roll clockwise 3 clicks,
 * then counterclockwise 3 clicks, and the original window is focused again.
 *
 * Alt+Tab cannot do this. Its list is most-recently-used, so once Alt is
 * released the path you walked is gone and rolling back does not retrace it.
 *
 * Alt releases after release-after-ms of idle, or when another key is pressed.
 */

#include <dt-bindings/zmk/keys.h>

/ {
	behaviors {
		at: alt_tab {
			compatible = "zmk,behavior-alt-tab";
			#binding-cells = <1>;
			display-name = "Alt-Esc";
			hold-key = <LEFT_ALT>;
			release-after-ms = <200>;
		};
	};
};
