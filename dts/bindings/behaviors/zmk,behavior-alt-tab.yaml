## dts/bindings/behaviors/zmk,behavior-alt-tab.yaml
```yaml
description: |
  Encoder window cycle. Each activation ensures the hold-key (Left Alt) is
  down, then taps param1. Use Esc and Shift+Esc so Alt+Esc and Alt+Shift+Esc
  rotate the window stack in opposite directions. Those stay inverses after
  the window opens: N clicks one way and N the other return to the same app.
  Alt stays down across activations and releases after release-after-ms.

compatible: "zmk,behavior-alt-tab"

include: one_param.yaml

properties:
  hold-key:
    type: int
    required: true
    description: Encoded keycode of the modifier to hold across activations (e.g. LEFT_ALT).
  release-after-ms:
    type: int
    default: 200
    description: Milliseconds of inactivity after which the held modifier is released.
```

## dts/bindings/behaviors/zmk,behavior-axis-lock-toggle.yaml
```yaml
description: |
  Toggle the scroll-layer axis lock between Y-only and X-only.

compatible: "zmk,behavior-axis-lock-toggle"

include: zero_param.yaml
```

## dts/bindings/behaviors/zmk,behavior-axis-lock.yaml
```yaml
description: |
  Scroll-axis lock control. Tap toggles Y-only ↔ X-only permanently; hold
  temporarily uses the other axis until release; double-tap releases both
  axes (free X+Y).

compatible: "zmk,behavior-axis-lock"

include: zero_param.yaml

properties:
  tapping-term-ms:
    type: int
    default: 200
    description: >
      Hold longer than this to momentary-swap instead of toggle. Also the
      window after a tap in which a second tap counts as double-tap (release
      both axes).
```

## dts/bindings/behaviors/zmk,behavior-mclk-alt.yaml
```yaml
description: |
  Middle-button undecided: ball motion holds middle-click; left encoder
  resolves to Left Alt (use with zmk,behavior-middle-encoder-alt).

compatible: "zmk,behavior-mclk-alt"

include: zero_param.yaml

properties:
  motion-threshold:
    type: int
    default: 2
    description: Absolute REL_X/Y value needed to resolve as middle-click hold.
```

## dts/bindings/behaviors/zmk,behavior-middle-encoder-alt.yaml
```yaml
description: |
  Left-encoder binding for middle-undecided Alt-Tab. If middle is undecided,
  resolves it to Left Alt, then taps param1 (TAB or LS(TAB)).

compatible: "zmk,behavior-middle-encoder-alt"

include: one_param.yaml
```

## dts/bindings/input_processors/zmk,input-processor-axis-lock.yaml
```yaml
description: |
  Hard-locks relative X/Y motion to a single axis (used on the scroll layer).
  Default is Y-only; pair with zmk,behavior-axis-lock to toggle, hold-swap,
  or double-tap release both.

compatible: "zmk,input-processor-axis-lock"

include: ip_zero_param.yaml
```

## dts/bindings/input_processors/zmk,input-processor-mclk-alt.yaml
```yaml
description: |
  Commits undecided middle-button to MCLK hold when the ball moves.

compatible: "zmk,input-processor-mclk-alt"

include: ip_zero_param.yaml
```
